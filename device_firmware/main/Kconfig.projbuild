## device_firmware/main/Kconfig.projbuild
```kconfig
menu "TapGate Settings"

    menu "Device Configuration"
        config TAPGATE_MAX_CLIENTS_DB
            int "Capacity enrolled clients"
            range 1 100
            default 50
            help
                Specifies the device capacity for client enrollment.

        config TAPGATE_DEVICE_DEFAULT_NAME
            string "Default Device Name"
            default "TapGate v1"
            help
                Default device name to use if not configured otherwise.
                Maximum length **31 characters** (exceeding this may be truncated at build time).
    endmenu

    menu "Available Channels"
        config TAPGATE_CHANNEL_BLE
            bool "BLE Channel"
            default y
            help
                Enable Bluetooth Low Energy communication channel.

            if TAPGATE_CHANNEL_BLE
                menu "BLE UUID Settings"
                    config TAPGATE_BLE_SERVICE_UUID
                        string "Service UUID"
                        default "A9CA DC24-0EE5-A9E0-93F3-A3B501004061"
                        help
                            128-bit UUID for the main service.

                    config TAPGATE_BLE_RX_UUID
                        string "RX Characteristic UUID"
                        default "B9CA DC24-0EE5-A9E0-93F3-A3B502004062"
                        help
                            128-bit UUID for the RX characteristic.

                    config TAPGATE_BLE_TX_UUID
                        string "TX Characteristic UUID"
                        default "C9CA DC24-0EE5-A9E0-93F3-A3B503004063"
                        help
                            128-bit UUID for the TX characteristic.

                    config TAPGATE_BLE_PREFERRED_MTU
                        int "Preferred MTU Size"
                        range 23 517
                        default 256
                        help
                            Preferred Maximum Transmission Unit size for BLE connections.
                endmenu
            endif
                
        config TAPGATE_CHANNEL_DUMMY
            bool "Dummy Channel"
            default n
            help
                Enable a fake/test channel for diagnostic purposes.
    endmenu
    
    menuconfig TAPGATE_DEBUG_MODE
        bool "Debug Mode"
        default n
        select FREERTOS_USE_TRACE_FACILITY
        select FREERTOS_GENERATE_RUN_TIME_STATS
        help
            Provides enhanced logging and diagnostic capabilities.
            Enabling this will also force FreeRTOS to collect runtime statistics.

    if TAPGATE_DEBUG_MODE
        config TAPGATE_DIAG_INITIAL_PAUSE
            int "Initial pause before first Diagnostic report (seconds)"
            range 0 3600
            default 3
            help
                How many seconds to wait before the very first diagnostic output 
                after the system starts.

        config TAPGATE_DIAG_INTERVAL
            int "Console diagnostic reporting interval (seconds)"
            range 1 86400
            default 60
            help
                The timeout between subsequent diagnostic information logs.

        config TAPGATE_DIAG_FULL
            bool "Full console diagnostic output"
            default y
            help
                SHORT mode: heap, fragmentation, and critical/delta tasks only.
                FULL mode: full diagnostic information for all tasks.
    endif

endmenu
```

## tapgate_firmware/main/Kconfig.projbuild
```kconfig
menu "TapGate Additional Debug Settings"

    config APP_DEBUG_MODE
        bool "Enable Application Debug Mode"
        default n
        select ESP_PANIC_HANDLER_IRAM
        select ESP_DEBUG_STUBS_ENABLE
        select ESP_DEBUG_OCDAWARE        
        help
            Global switch for APP debug features.

    config APP_WAIT_FOR_DEBUGGER
        bool "Wait for debugger attachment"
        depends on APP_DEBUG_MODE
        default y
        help
            Forces the app to wait for a JTAG/GDB connection before proceeding.

    config APP_WAIT_FOR_DEBUGGER_TIMEOUT
        int "Debugger connection timeout (seconds)"
        depends on APP_WAIT_FOR_DEBUGGER
        default 15
        range 0 3600
        help
            Time in seconds to wait for a debugger. 
            If 0, the application will wait indefinitely.

endmenu

menu "TapGate Settings"

        config TAPGATE_DEVICE_DEFAULT_NAME
            string "Default Device Name"
            default "TapGate v1"
            help
                Default device name to use if not configured otherwise.
                Maximum length **31 characters** (exceeding this may be truncated at build time).    

        config TAPGATE_MAX_CLIENTS_DB
            int "Capacity enrolled clients"
            range 1 100
            default 50
            help
                Specifies the device capacity for client enrollment.
endmenu
```

## tapgate_firmware/sdkconfig.defaults
```kconfig
CONFIG_COMPILER_CXX_EXCEPTIONS=n
CONFIG_COMPILER_CXX_RTTI=n
CONFIG_COMPILER_OPTIMIZATION_LEVEL_DEBUG=y
CONFIG_COMPILER_OPTIMIZATION_ASSERTIONS_DISABLE=y
CONFIG_LIBC_NEWLIB_NANO_FORMAT=y
CONFIG_FREERTOS_GENERATE_RUN_TIME_STATS=n
CONFIG_APP_REPRODUCIBLE_BUILD=y

# IWDT timeout extended for JTAG debugging.
# OpenOCD halts the CPU during launch.json setupCommands (set var dbg_ready,
# tbreak, symbol loading). During a CPU halt the IWDT keeps counting; if the
# halt exceeds the default 300 ms the IWDT fires a spurious "Guru Meditation
# Error". 10 s covers GDB symbol-load time.
CONFIG_ESP_INT_WDT_TIMEOUT_MS=10000


# Partition Table
#
# CONFIG_PARTITION_TABLE_SINGLE_APP is not set
# CONFIG_PARTITION_TABLE_SINGLE_APP_LARGE is not set
# CONFIG_PARTITION_TABLE_TWO_OTA is not set
# CONFIG_PARTITION_TABLE_TWO_OTA_LARGE is not set
CONFIG_PARTITION_TABLE_CUSTOM=y
CONFIG_PARTITION_TABLE_CUSTOM_FILENAME="partitions.csv"
# default:
CONFIG_PARTITION_TABLE_FILENAME="partitions.csv"
# default:
CONFIG_PARTITION_TABLE_OFFSET=0x8000
# default:
CONFIG_PARTITION_TABLE_MD5=y
# end of Partition Table
```

## tapgate_firmware/tests/common/sdkconfig.defaults
```kconfig
CONFIG_IDF_TARGET="esp32"
CONFIG_ESPTOOLPY_FLASHSIZE_4MB=y
CONFIG_UNITY_ENABLE_FLOAT=y
CONFIG_UNITY_ENABLE_DOUBLE=y
CONFIG_ESP_TASK_WDT_EN=n
CONFIG_COMPILER_OPTIMIZATION_ASSERTIONS_ENABLE=y
CONFIG_UNITY_ENABLE_IDF_TEST_RUNNER=y
CONFIG_PARTITION_TABLE_CUSTOM_FILENAME="../../partitions.csv"
```
